#include <dt-bindings/gpio/gpio.h>
#include <dt-bindings/zmk/matrix_transform.h>

/ {
    chosen {
        zmk,kscan = &kscan0;
        zmk,matrix-transform = &default_transform;
    };

    kscan0: kscan {
        compatible = "zmk,kscan-gpio-direct";
        wakeup-source;

        input-gpios
            = <&gpio0 6 (GPIO_ACTIVE_LOW | GPIO_PULL_UP)>  /* P0.06 / синяя */
            , <&gpio0 8 (GPIO_ACTIVE_LOW | GPIO_PULL_UP)>  /* P0.08 / красная */
            ;
    };

    default_transform: matrix_transform {
        compatible = "zmk,matrix-transform";
        rows = <1>;
        columns = <2>;
        map = <
            RC(0,0) RC(0,1)
        >;
    };
};
